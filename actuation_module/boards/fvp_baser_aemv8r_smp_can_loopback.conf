## actuation_module/boards/fvp_baser_aemv8r_smp_output_can_only.conf
```kconfig
# Copyright (c) 2026, Arm Limited.
# SPDX-License-Identifier: Apache-2.0

CONFIG_CONTROL_CMD_OUTPUT_CAN_ONLY=y
```

## actuation_module/boards/fvp_baser_aemv8r_smp_output_dds_and_can.conf
```kconfig
# Copyright (c) 2026, Arm Limited.
# SPDX-License-Identifier: Apache-2.0

CONFIG_CONTROL_CMD_OUTPUT_DDS_AND_CAN=y
```
