## actuation_module/Kconfig
```kconfig
# Copyright (c) 2023, Arm Limited.
# SPDX-License-Identifier: Apache-2.0

config ENABLE_SNTP
	bool "Enable SNTP"
	default n
	help
	  Synchronizes the clock of the system using NTP server.(Requires internet connection)
	  Disabling means that the timestamps will start from boot up time.

config DDS_DOMAIN_ID
	int "Domain ID for CycloneDDS"
	default 2
	help
		This config sets the domain ID for CycloneDDS.

config DDS_NETWORK_INTERFACE
	string "Name of the network interface to be used by CycloneDDS"
	default ""
	help
	  When left undefined, CycloneDDS will automatically select an interface
	  based on its own criteria.

config LOG_LEVEL
	int "Log level for actuation module"
	default 1
	range 0 2
	help
	  This config sets the log level for actuation module.
	  0: No logs
	  1: Fatal, Error, Warning, Config
	  2: Debug
	  It is used to limit the rate of messages being published to the console.

config LOG_THROTTLE_RATE
	int "Throttle rate for rclcpp info"
	default 3
	help
	  This config sets the throttle rate in seconds for rclcpp-like messages.
	  It is used to limit the rate of messages being published to the console.

config DDS_LOG_LEVEL
	int "Log level for CycloneDDS"
	default 0
	range 0 2
	help
	  This config sets the log level for CycloneDDS.
	  0: No logs
	  1: Fatal, Error, Warning, Config
	  2: Debug
	  It is used to limit the rate of messages being published to the console.

choice CONTROL_CMD_OUTPUT_MODE
	prompt "Control command output mode"
	default CONTROL_CMD_OUTPUT_DDS_ONLY
	help
	  Select where final actuation control commands are sent.

config CONTROL_CMD_OUTPUT_DDS_ONLY
	bool "DDS only"
	help
	  Publish final control commands only through DDS.

config CONTROL_CMD_OUTPUT_CAN_ONLY
	bool "CAN only"
	select CAN
	help
	  Send final control commands only through CAN.

config CONTROL_CMD_OUTPUT_DDS_AND_CAN
	bool "DDS and CAN"
	select CAN
	help
	  Publish final control commands through DDS and send placeholder CAN frames.

endchoice

config CONTROL_CMD_CAN_OUTPUT
	bool
	default y if CONTROL_CMD_OUTPUT_CAN_ONLY || CONTROL_CMD_OUTPUT_DDS_AND_CAN

config CONTROL_CMD_DDS_OUTPUT
	bool
	default y if CONTROL_CMD_OUTPUT_DDS_ONLY || CONTROL_CMD_OUTPUT_DDS_AND_CAN

# TODO: Fine tune this if things go wrong with the stack size
config THREAD_STACK_SIZE
	int "Stack size for threads"
	default 262144
	help
	  This config sets the stack size for threads.
	  It is used to limit the stack size for user threads.

# Override the range of MAX_PTHREAD_MUTEX_COUNT from zephyr/lib/posix/Kconfig
config MAX_PTHREAD_MUTEX_COUNT
	range 0 30000

config NET_IFACE1_ADDR
	string "Address for interface 1"
	default ""

config NET_IFACE1_GW
	string "Gateway for interface 1"
	default ""

config NET_IFACE1_NETMASK
	string "Netmask for interface 1"
	default ""

config NET_IFACE1_VLAN
	int "VLAN identifier for interface 1"
	default 0
	help
	  When different from 0, it sets the VLAN id for the interface 1.
	  Use 0 here if uncertain.

config NET_IFACE2_ADDR
	string "Address for interface 2"
	default ""

config NET_IFACE2_GW
	string "Gateway for interface 2"
	default ""

config NET_IFACE2_NETMASK
	string "Netmask for interface 2"
	default ""

config NET_IFACE2_VLAN
	int "VLAN identifier for interface 2"
	default 0
	help
	  When different from 0, it sets the VLAN id for the interface 2.
	  Use 0 here if uncertain.



source "Kconfig.zephyr"
```

## actuation_module/boards/fvp_baser_aemv8r_smp_actuation.conf
```kconfig
# Copyright (c) 2024-2025, Arm Limited.
# SPDX-License-Identifier: Apache-2.0

# DDS network interface
CONFIG_DDS_NETWORK_INTERFACE="ethernet"

# Control command output mode
CONFIG_CONTROL_CMD_OUTPUT_DDS_ONLY=y

# MDIO
CONFIG_MDIO=y

CONFIG_MDIO_INIT_PRIORITY=81
CONFIG_PHY_INIT_PRIORITY=82
# Use out of order priorities in order to work around a limitation in the
# SMSC91C111 driver in Zephyr.
CONFIG_ETH_INIT_PRIORITY=80
CONFIG_CHECK_INIT_PRIORITIES=n
```

## actuation_module/boards/s32z270dc2_rtu0_r52_actuation.conf
```kconfig
# Copyright (c) 2023, Arm Limited.
# SPDX-License-Identifier: Apache-2.0

# DDS network interface
CONFIG_DDS_NETWORK_INTERFACE="ethernet@74b00000"

# Control command output mode
CONFIG_CONTROL_CMD_OUTPUT_DDS_AND_CAN=y

# Network RX thread stack size
CONFIG_ETH_NXP_S32_RX_THREAD_STACK_SIZE=16384
```
